# file: DAQfirmware3.ioc
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CORTEX_M7.default_mode_Activation=1
CortexM4.IPs=CORTEX_M4\:I,FATFS_M4\:I,FREERTOS_M4\:I,IWDG2\:I,OPENAMP_M4\:I,PDM2PCM_M4\:I,PWR,RCC,RESMGR_UTILITY,SYS_M4\:I,USB_DEVICE_M4\:I,USB_HOST_M4\:I,VREFBUF,WWDG2\:I,GPIO,DMA,BDMA,MDMA,NVIC2\:I
CortexM7.IPs=CORTEX_M7\:I,FATFS_M7\:I,FREERTOS_M7\:I,IWDG1\:I,OPENAMP_M7\:I,PDM2PCM_M7\:I,PWR\:I,RCC\:I,RESMGR_UTILITY\:I,SYS\:I,USB_DEVICE_M7\:I,USB_HOST_M7\:I,VREFBUF\:I,WWDG1\:I,GPIO\:I,DMA\:I,BDMA\:I,MDMA\:I,NVIC1\:I,SPI1\:I
Mcu.Family=STM32H7
Mcu.Name=STM32H745IITx
Mcu.Package=LQFP176
NVIC1.PriorityGroup=NVIC_PRIORITYGROUP_4
NVIC2.PriorityGroup=NVIC_PRIORITYGROUP_4
PA4.PinAttribute=CortexM7
PA4.Signal=SPI1_NSS
PA5.PinAttribute=CortexM7
PA5.Signal=SPI1_SCK
PA6.PinAttribute=CortexM7
PA6.Signal=SPI1_MISO
PA7.PinAttribute=CortexM7
PA7.Signal=SPI1_MOSI
ProjectManager.HeapSize=M4-0x200,M7-0x200
ProjectManager.StackSize=M4-0x400,M7-0x400
ProjectManager.TargetToolchain=Makefile
RCC.ADCFreq_Value=129000000
RCC.APB1Freq_Value=64000000
RCC.APB2Freq_Value=64000000
RCC.APB3Freq_Value=64000000
RCC.APB4Freq_Value=64000000
RCC.CortexFreq_Value=64000000
RCC.HCLKFreq_Value=64000000
RCC.SYSCLKFreq_VALUE=64000000
RCC.USBFreq_Value=129000000
SYS.userName=SYS_M7
VP_SYS_M4_VS_Systick.Mode=SysTick
board=custom

// file: CM7/Core/Src/main.c
/* USER CODE BEGIN Header */
/**
  ******************************************************************************
  * @file           : main.c
  * @brief          : Main program body
  ******************************************************************************
  * @attention
  *
  * Copyright (c) 2026 STMicroelectronics.
  * All rights reserved.
  *
  * This software is licensed under terms that can be found in the LICENSE file
  * in the root directory of this software component.
  * If no LICENSE file comes with this software, it is provided AS-IS.
  *
  ******************************************************************************
  */
/* USER CODE END Header */
#include "main.h"

/* USER CODE BEGIN Includes */
#include "ads7066.h"
#include "daq_board.h"
#include "daq_timing.h"
#include "spi_bus.h"
/* USER CODE END Includes */

/* USER CODE BEGIN PTD */
typedef struct
{
  uint16_t tc_raw[ADS7066_NUM_CHANNELS]; /* thermocouple amp outputs, AIN0-AIN7 */
  uint16_t pt_raw[ADS7066_NUM_CHANNELS]; /* pressure transducer / load cell inputs, AIN0-AIN7 */
  uint32_t sample_count;
  uint32_t error_count;   /* failed ADC reads; the previous values are kept */
  uint32_t overrun_count; /* sample periods missed because a read ran long */
  uint32_t read_us_max;   /* longest read of both ADCs; must stay well under the period */
  HAL_StatusTypeDef tc_init_status; /* an ADC that failed init is not read */
  HAL_StatusTypeDef pt_init_status;
} daq_sample_t;
/* USER CODE END PTD */

/* USER CODE BEGIN PD */
/* Per channel, all 16 channels. Each read of both ADCs takes well under 1 ms. */
#define DAQ_SAMPLE_RATE_HZ 1000U
_Static_assert(DAQ_SAMPLE_RATE_HZ >= 500U, "Requirement: at least 500 Hz per channel");

/* DUAL_CORE_BOOT_SYNC_SEQUENCE: Define for dual core boot synchronization    */
/*                             demonstration code based on hardware semaphore */
/* This define is present in both CM7/CM4 projects                            */
/* To comment when developping/debugging on a single core                     */
#define DUAL_CORE_BOOT_SYNC_SEQUENCE

#if defined(DUAL_CORE_BOOT_SYNC_SEQUENCE)
#ifndef HSEM_ID_0
#define HSEM_ID_0 (0U) /* HW semaphore 0*/
#endif
#endif /* DUAL_CORE_BOOT_SYNC_SEQUENCE */

/* USER CODE END PD */

/* USER CODE BEGIN PV */
/* Bring-up only: watch this in the debugger. Nothing logs it yet (SD card to come). */
static volatile daq_sample_t daq_sample;
/* USER CODE END PV */

void SystemClock_Config(void);
static void MPU_Config(void);
static void MX_GPIO_Init(void);

/* USER CODE BEGIN 0 */
static void daq_count_status(HAL_StatusTypeDef status)
{
  if (status != HAL_OK)
  {
    daq_sample.error_count = daq_sample.error_count + 1U;
  }
}

static void daq_read_adc(spi_bus_dev_t dev, HAL_StatusTypeDef init_status,
                         volatile uint16_t out[ADS7066_NUM_CHANNELS])
{
  uint16_t raw[ADS7066_NUM_CHANNELS];
  HAL_StatusTypeDef status;

  if (init_status != HAL_OK)
  {
    return;
  }
  status = ads7066_read_all(dev, raw);
  daq_count_status(status);
  if (status == HAL_OK)
  {
    for (uint32_t ch = 0U; ch < ADS7066_NUM_CHANNELS; ch++)
    {
      out[ch] = raw[ch];
    }
  }
}

/* A failed read only bumps error_count, so the other ADC keeps reading */
static void daq_read_all(void)
{
  const uint32_t start = daq_timing_cycles();
  uint32_t elapsed_us;

  daq_read_adc(SPI_BUS_DEV_TC_ADC, daq_sample.tc_init_status, daq_sample.tc_raw);
  daq_read_adc(SPI_BUS_DEV_PT_ADC, daq_sample.pt_init_status, daq_sample.pt_raw);

  elapsed_us = (daq_timing_cycles() - start) / (SystemCoreClock / 1000000U);
  if (elapsed_us > daq_sample.read_us_max)
  {
    daq_sample.read_us_max = elapsed_us;
  }
  daq_sample.sample_count = daq_sample.sample_count + 1U;
}
/* USER CODE END 0 */

int main(void)
{

/* USER CODE BEGIN Boot_Mode_Sequence_0 */
#if defined(DUAL_CORE_BOOT_SYNC_SEQUENCE)
  int32_t timeout;
#endif /* DUAL_CORE_BOOT_SYNC_SEQUENCE */
/* USER CODE END Boot_Mode_Sequence_0 */

  /* MPU Configuration--------------------------------------------------------*/
  MPU_Config();

/* USER CODE BEGIN Boot_Mode_Sequence_1 */
#if defined(DUAL_CORE_BOOT_SYNC_SEQUENCE)
  /* Wait until CPU2 boots and enters in stop mode or timeout*/
  timeout = 0xFFFF;
  while((__HAL_RCC_GET_FLAG(RCC_FLAG_D2CKRDY) != RESET) && (timeout-- > 0));
  if ( timeout < 0 )
  {
  Error_Handler();
  }
#endif /* DUAL_CORE_BOOT_SYNC_SEQUENCE */
/* USER CODE END Boot_Mode_Sequence_1 */
  /* MCU Configuration--------------------------------------------------------*/

  /* Reset of all peripherals, Initializes the Flash interface and the Systick. */
  HAL_Init();

  /* Configure the system clock */
  SystemClock_Config();
/* USER CODE BEGIN Boot_Mode_Sequence_2 */
#if defined(DUAL_CORE_BOOT_SYNC_SEQUENCE)
/* When system initialization is finished, Cortex-M7 will release Cortex-M4 by means of
HSEM notification */
/*HW semaphore Clock enable*/
__HAL_RCC_HSEM_CLK_ENABLE();
/*Take HSEM */
HAL_HSEM_FastTake(HSEM_ID_0);
/*Release HSEM in order to notify the CPU2(CM4)*/
HAL_HSEM_Release(HSEM_ID_0,0);
/* wait until CPU2 wakes up from stop mode */
timeout = 0xFFFF;
while((__HAL_RCC_GET_FLAG(RCC_FLAG_D2CKRDY) == RESET) && (timeout-- > 0));
if ( timeout < 0 )
{
Error_Handler();
}
#endif /* DUAL_CORE_BOOT_SYNC_SEQUENCE */
/* USER CODE END Boot_Mode_Sequence_2 */

  /* Initialize all configured peripherals */
  MX_GPIO_Init();
  /* USER CODE BEGIN 2 */
  daq_timing_init();
  if (spi_bus_init() != HAL_OK)
  {
    Error_Handler();
  }
  HAL_Delay(5); /* ADS7066 power-up time, tPU */
  {
    const ads7066_config_t tc_cfg = {.internal_ref = DAQ_ADC_TC_INTERNAL_REF};
    const ads7066_config_t pt_cfg = {.internal_ref = DAQ_ADC_PT_INTERNAL_REF};
    daq_sample.tc_init_status = ads7066_init(SPI_BUS_DEV_TC_ADC, &tc_cfg);
    daq_sample.pt_init_status = ads7066_init(SPI_BUS_DEV_PT_ADC, &pt_cfg);
  }
  const uint32_t period = SystemCoreClock / DAQ_SAMPLE_RATE_HZ;
  uint32_t next = daq_timing_cycles() + period;
  /* USER CODE END 2 */

  /* Infinite loop */
  while (1)
  {

    /* USER CODE BEGIN 3 */
    /* Fixed-rate schedule from the cycle counter, so read time does not add to the period */
    while ((int32_t)(daq_timing_cycles() - next) < 0)
    {
    }
    daq_read_all();
    next += period;
    if ((int32_t)(daq_timing_cycles() - next) >= 0)
    {
      /* Missed a period: count it and start a fresh schedule instead of bursting to catch up */
      daq_sample.overrun_count = daq_sample.overrun_count + 1U;
      next = daq_timing_cycles() + period;
    }
  }
  /* USER CODE END 3 */
}

void SystemClock_Config(void)
{
  RCC_OscInitTypeDef RCC_OscInitStruct = {0};
  RCC_ClkInitTypeDef RCC_ClkInitStruct = {0};

  /** Supply configuration update enable
  */
  HAL_PWREx_ConfigSupply(PWR_DIRECT_SMPS_SUPPLY);

  /** Configure the main internal regulator output voltage
  */
  __HAL_PWR_VOLTAGESCALING_CONFIG(PWR_REGULATOR_VOLTAGE_SCALE3);

  while(!__HAL_PWR_GET_FLAG(PWR_FLAG_VOSRDY)) {}

  /** Initializes the RCC Oscillators according to the specified parameters
  * in the RCC_OscInitTypeDef structure.
  */
  RCC_OscInitStruct.OscillatorType = RCC_OSCILLATORTYPE_HSI;
  RCC_OscInitStruct.HSIState = RCC_HSI_DIV1;
  RCC_OscInitStruct.HSICalibrationValue = RCC_HSICALIBRATION_DEFAULT;
  RCC_OscInitStruct.PLL.PLLState = RCC_PLL_NONE;
  if (HAL_RCC_OscConfig(&RCC_OscInitStruct) != HAL_OK)
  {
    Error_Handler();
  }

  /** Initializes the CPU, AHB and APB buses clocks
  */
  RCC_ClkInitStruct.ClockType = RCC_CLOCKTYPE_HCLK|RCC_CLOCKTYPE_SYSCLK
                              |RCC_CLOCKTYPE_PCLK1|RCC_CLOCKTYPE_PCLK2
                              |RCC_CLOCKTYPE_D3PCLK1|RCC_CLOCKTYPE_D1PCLK1;
  RCC_ClkInitStruct.SYSCLKSource = RCC_SYSCLKSOURCE_HSI;
  RCC_ClkInitStruct.SYSCLKDivider = RCC_SYSCLK_DIV1;
  RCC_ClkInitStruct.AHBCLKDivider = RCC_HCLK_DIV1;
  RCC_ClkInitStruct.APB3CLKDivider = RCC_APB3_DIV1;
  RCC_ClkInitStruct.APB1CLKDivider = RCC_APB1_DIV1;
  RCC_ClkInitStruct.APB2CLKDivider = RCC_APB2_DIV1;
  RCC_ClkInitStruct.APB4CLKDivider = RCC_APB4_DIV1;

  if (HAL_RCC_ClockConfig(&RCC_ClkInitStruct, FLASH_LATENCY_1) != HAL_OK)
  {
    Error_Handler();
  }
}

static void MX_GPIO_Init(void)
{
  GPIO_InitTypeDef GPIO_InitStruct = {0};

  /* GPIO Ports Clock Enable */
  __HAL_RCC_GPIOA_CLK_ENABLE();

  /*Configure GPIO pins : PA4 PA5 PA6 PA7 */
  GPIO_InitStruct.Pin = GPIO_PIN_4|GPIO_PIN_5|GPIO_PIN_6|GPIO_PIN_7;
  GPIO_InitStruct.Mode = GPIO_MODE_AF_PP;
  GPIO_InitStruct.Pull = GPIO_NOPULL;
  GPIO_InitStruct.Speed = GPIO_SPEED_FREQ_LOW;
  GPIO_InitStruct.Alternate = GPIO_AF5_SPI1;
  HAL_GPIO_Init(GPIOA, &GPIO_InitStruct);

}

 /* MPU Configuration */

void MPU_Config(void)
{
  MPU_Region_InitTypeDef MPU_InitStruct = {0};

  /* Disables the MPU */
  HAL_MPU_Disable();

  /** Initializes and configures the Region and the memory to be protected
  */
  MPU_InitStruct.Enable = MPU_REGION_ENABLE;
  MPU_InitStruct.Number = MPU_REGION_NUMBER0;
  MPU_InitStruct.BaseAddress = 0x0;
  MPU_InitStruct.Size = MPU_REGION_SIZE_4GB;
  MPU_InitStruct.SubRegionDisable = 0x87;
  MPU_InitStruct.TypeExtField = MPU_TEX_LEVEL0;
  MPU_InitStruct.AccessPermission = MPU_REGION_NO_ACCESS;
  MPU_InitStruct.DisableExec = MPU_INSTRUCTION_ACCESS_DISABLE;
  MPU_InitStruct.IsShareable = MPU_ACCESS_SHAREABLE;
  MPU_InitStruct.IsCacheable = MPU_ACCESS_NOT_CACHEABLE;
  MPU_InitStruct.IsBufferable = MPU_ACCESS_NOT_BUFFERABLE;

  HAL_MPU_ConfigRegion(&MPU_InitStruct);
  /* Enables the MPU */
  HAL_MPU_Enable(MPU_PRIVILEGED_DEFAULT);

}

void Error_Handler(void)
{
  __disable_irq();
  while (1)
  {
  }
}
